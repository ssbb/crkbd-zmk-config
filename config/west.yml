## config/west.yml
```yaml
manifest:
  remotes:
    - name: zmkfirmware
      url-base: https://github.com/zmkfirmware
    - name: katona
      url-base: https://github.com/Katona/
  projects:
    - name: zmk
      remote: katona
      revision: split_battery_service
      import: app/west.yml
  self:
    path: config
```
